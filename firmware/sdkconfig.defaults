## firmware/sdkconfig.defaults
```kconfig
# Target Configuration
CONFIG_IDF_TARGET="esp32s3"

# TinyUSB Configuration
CONFIG_TINYUSB_ENABLED=y
CONFIG_TINYUSB_HID_ENABLED=y

# I2C Configuration
CONFIG_I2C_ENABLE_DEBUG_LOG=y

# NVS Configuration
CONFIG_NVS_ENCRYPTION=n

# FreeRTOS Configuration
CONFIG_FREERTOS_HZ=1000

# USB Configuration
CONFIG_ESP_CONSOLE_USB_SERIAL_JTAG=n
CONFIG_ESP_CONSOLE_UART=y
```

## sdkconfig.defaults
```kconfig
# ESP32-S3 Configuration
CONFIG_IDF_TARGET="esp32s3"

# Disable Bluetooth
CONFIG_BT_ENABLED=n

# Disable WiFi
CONFIG_ESP_WIFI_ENABLED=n

# Logging
CONFIG_LOG_DEFAULT_LEVEL_INFO=y
CONFIG_LOG_MAXIMUM_LEVEL_VERBOSE=y

# FreeRTOS
CONFIG_FREERTOS_HZ=1000
```

## tests/unit/sdkconfig.defaults
```kconfig
# Target Configuration
CONFIG_IDF_TARGET="esp32s3"

# TinyUSB Configuration
CONFIG_TINYUSB_ENABLED=y
CONFIG_TINYUSB_HID_ENABLED=y

# Unity Test Framework
CONFIG_UNITY_ENABLE_FLOAT=y
CONFIG_UNITY_ENABLE_DOUBLE=y

# Console Configuration
CONFIG_ESP_CONSOLE_USB_SERIAL_JTAG=n
CONFIG_ESP_CONSOLE_UART=y
```
